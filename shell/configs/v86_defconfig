## shell/configs/v86_defconfig
```kconfig
BR2_x86_i686=y
BR2_WGET="wget --passive-ftp -nd -t 3"
BR2_DL_DIR="/var/cache/buildroot/dl"
BR2_HOST_DIR="/var/cache/buildroot/host"
BR2_BACKUP_SITE="http://sources.buildroot.net"
BR2_CPAN_MIRROR="http://cpan.metacpan.org"
BR2_CCACHE=y
BR2_CCACHE_DIR="/var/cache/buildroot/ccache"
BR2_OPTIMIZE_S=y
BR2_ENABLE_LTO=y
BR2_PER_PACKAGE_DIRECTORIES=y
# BR2_PIC_PIE is not set
BR2_RELRO_NONE=y
# BR2_TARGET_ENABLE_ROOT_LOGIN is not set
BR2_ENABLE_LOCALE_WHITELIST="C.UTF-8"
BR2_ROOTFS_OVERLAY="$(BR2_EXTERNAL)/board/$(ACTIVE_PROJECT)/rootfs_overlay"
BR2_LINUX_KERNEL=y
BR2_LINUX_KERNEL_USE_CUSTOM_CONFIG=y
BR2_LINUX_KERNEL_CUSTOM_CONFIG_FILE="$(BR2_EXTERNAL)/board/$(ACTIVE_PROJECT)/linux.config"
BR2_LINUX_KERNEL_ZSTD=y
BR2_PACKAGE_BUSYBOX_CONFIG="$(BR2_EXTERNAL)/board/$(ACTIVE_PROJECT)/busybox.config"
BR2_PACKAGE_LUA=y
BR2_PACKAGE_LUASOCKET=y
BR2_PACKAGE_QUICKJS=y
BR2_PACKAGE_CA_CERTIFICATES=y
BR2_PACKAGE_MBEDTLS=y
BR2_PACKAGE_SQLITE=y
BR2_PACKAGE_LIBCURL=y
BR2_PACKAGE_LIBCURL_CURL=y
# BR2_PACKAGE_LIBCURL_PROXY_SUPPORT is not set
# BR2_PACKAGE_LIBCURL_COOKIES_SUPPORT is not set
# BR2_PACKAGE_LIBCURL_EXTRA_PROTOCOLS_FEATURES is not set
BR2_PACKAGE_LIBTELNET=y
BR2_PACKAGE_NCURSES_WCHAR=y
BR2_PACKAGE_DNSMASQ=y
# BR2_PACKAGE_IFUPDOWN_SCRIPTS is not set
BR2_PACKAGE_IPUTILS=y
BR2_PACKAGE_LINKS=y
BR2_PACKAGE_NTP=y
BR2_PACKAGE_NTP_NTPDATE=y
BR2_PACKAGE_NTP_NTPQ=y
BR2_PACKAGE_NTP_NTPTIME=y
BR2_PACKAGE_SOCAT=y
BR2_PACKAGE_TCPDUMP=y
BR2_PACKAGE_TCPING=y
BR2_PACKAGE_TINYSSH=y
BR2_PACKAGE_UTIL_LINUX=y
BR2_PACKAGE_UTIL_LINUX_LIBUUID=y
BR2_PACKAGE_NANO=y
BR2_TARGET_ROOTFS_CPIO_ZSTD=y
BR2_TARGET_ROOTFS_INITRAMFS=y
BR2_TARGET_ROOTFS_TAR_ZSTD=y
```
